## west.yml
```yaml
manifest:
  version: "0.10"
  projects:

   # nRF-Connect SDK
    - name: sdk-nrf
      path: nrf
      url: https://github.com/nrfconnect/sdk-nrf.git
      revision: main
      import: true
```
